## boards/shields/tastaturr/Kconfig.defconfig
```kconfig
if SHIELD_TASTATURR_LEFT

# Name must be less than 16 characters long!
config ZMK_KEYBOARD_NAME
    default "tastaturr"

config ZMK_SPLIT_ROLE_CENTRAL
    default y

config ZMK_WIDGET_WPM_STATUS
    bool
    default y

config ZMK_WPM 
    bool
    default y

endif

if SHIELD_TASTATURR_RIGHT

config ZMK_USB
    default n

endif

if SHIELD_TASTATURR_LEFT || SHIELD_TASTATURR_RIGHT

config ZMK_SPLIT
    default y

config ZMK_MOUSE
    bool
    default y

config ZMK_UNDERGLOW
    bool
    default y

config WS2812_STRIP
    bool
    default y

config LED
    bool
    default y

config ZMK_EVENT_MANAGER
    bool
    default y
endif
```

## boards/shields/tastaturr/Kconfig.shield
```kconfig
# No whitespace after the comma or in your part name!
config SHIELD_TASTATURR_LEFT
    def_bool $(shields_list_contains,tastaturr_left)

# No whitespace after the comma or in your part name!
config SHIELD_TASTATURR_RIGHT
    def_bool $(shields_list_contains,tastaturr_right)
```
